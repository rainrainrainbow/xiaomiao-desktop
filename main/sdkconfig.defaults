## sdkconfig.defaults
```kconfig
CONFIG_LV_CONF_SKIP=y
# LVGL 内存分配器改用标准 C malloc（替代 64KB 静态内存池 work_mem_int，消除 65536 BSS）
# 配合 CONFIG_SPIRAM_MALLOC_ALWAYSINTERNAL=16384：>16KB 分配自动进 PSRAM
CONFIG_LV_USE_CLIB_MALLOC=y
CONFIG_LV_USE_BUILTIN_MALLOC=n
CONFIG_FREERTOS_HZ=1000
CONFIG_ESP_DEFAULT_CPU_FREQ_MHZ_240=y
CONFIG_ESP_DEFAULT_CPU_FREQ_MHZ=240
CONFIG_ESPTOOLPY_FLASHMODE_QIO=y
# CONFIG_ESPTOOLPY_FLASHMODE_DIO is not set
CONFIG_ESPTOOLPY_FLASHFREQ_80M=y
CONFIG_ESPTOOLPY_FLASHFREQ="80m"
# CONFIG_ESPTOOLPY_FLASHSIZE_2MB is not set
CONFIG_ESPTOOLPY_FLASHSIZE_4MB=y
CONFIG_ESPTOOLPY_FLASHSIZE="4MB"
# Custom partition table: factory(loader) + ota_0(ROM slot)
CONFIG_PARTITION_TABLE_CUSTOM=y
CONFIG_PARTITION_TABLE_CUSTOM_FILENAME="partitions.csv"
CONFIG_PARTITION_TABLE_FILENAME="partitions.csv"
CONFIG_PARTITION_TABLE_OFFSET=0x8000
CONFIG_COMPILER_OPTIMIZATION_SIZE=y
CONFIG_BOOTLOADER_COMPILER_OPTIMIZATION_SIZE=y
CONFIG_SPIRAM=y
CONFIG_SPIRAM_MODE_QUAD=y
CONFIG_SPIRAM_TYPE_AUTO=y
CONFIG_SPIRAM_SPEED_80M=y
CONFIG_SPIRAM_SPEED=80
CONFIG_SPIRAM_OCCUPY_VSPI_HOST=y
CONFIG_SPIRAM_USE_MALLOC=y
CONFIG_SPIRAM_TRY_ALLOCATE_WIFI_LWIP=y
CONFIG_SPIRAM_MALLOC_ALWAYSINTERNAL=16384
CONFIG_LV_COLOR_DEPTH_16=y
CONFIG_LV_DEF_REFR_PERIOD=16
CONFIG_LV_DPI_DEF=60
CONFIG_LV_USE_DRAW_SW=y
CONFIG_LV_DRAW_SW_SUPPORT_RGB565=y
CONFIG_LV_DRAW_SW_SUPPORT_RGB565_SWAPPED=y
CONFIG_LV_FONT_MONTSERRAT_8=y
CONFIG_LV_FONT_MONTSERRAT_10=y
CONFIG_LV_FONT_MONTSERRAT_12=y
CONFIG_LV_FONT_MONTSERRAT_14=y
# CONFIG_LV_FONT_MONTSERRAT_18 is not set
CONFIG_LV_FONT_DEFAULT_MONTSERRAT_10=y
# CJK 中文字体 - 使用 FreeType 引擎从 SD卡加载 NotoSansSC
# 内置位图字体（lv_font_xiaomiao_cn_14 约 371KB）已删除，改用 FreeType 渲染
# 字体文件位置：/sdcard/Fonts/NotoSansSC-Regular.otf
# CONFIG_LV_FONT_SOURCE_HAN_SANS_SC_14_CJK is not set
# CONFIG_LV_FONT_SOURCE_HAN_SANS_SC_16_CJK is not set
CONFIG_LV_USE_FREETYPE=y
# CONFIG_LV_USE_CHART is not set
# CONFIG_LV_USE_SYSMON is not set
# CONFIG_LV_USE_PERF_MONITOR is not set
CONFIG_LV_USE_PERF_MONITOR_LOG_MODE=n
# CONFIG_LV_BUILD_EXAMPLES is not set
# CONFIG_LV_USE_CALENDAR is not set
# CONFIG_LV_USE_TABVIEW is not set
# CONFIG_LV_USE_TILEVIEW is not set
# CONFIG_LV_USE_WIN is not set
# CONFIG_LV_USE_MSGBOX is not set
# CONFIG_LV_USE_SPAN is not set
# CONFIG_LV_USE_OBSERVER is not set
# CONFIG_LV_USE_ANIMIMG is not set
CONFIG_LV_USE_THEME_DEFAULT=y
# CONFIG_LV_USE_THEME_SIMPLE is not set
CONFIG_LV_USE_THEME_MONO=n
CONFIG_SPI_MASTER_IN_IRAM=n
CONFIG_SPI_MASTER_ISR_IN_IRAM=n
CONFIG_ESP_WIFI_IRAM_OPT=n
CONFIG_ESP_WIFI_RX_IRAM_OPT=n
CONFIG_LWIP_IRAM_OPTIMIZATION=n
CONFIG_ESP_MAIN_TASK_STACK_SIZE=8192
# 允许任务栈在外部 PSRAM 中运行（xTaskCreate 动态分配或 xTaskCreateStatic 静态分配均需此项）
CONFIG_SPIRAM_ALLOW_STACK_EXTERNAL_MEMORY=y
# FreeRTOS 创建任务时优先从 PSRAM 分配栈（v5.3 必需，配合 SPIRAM_ALLOW_STACK_EXTERNAL_MEMORY）
CONFIG_FREERTOS_TASK_CREATE_ALLOW_EXT_MEM=y
CONFIG_FREERTOS_PLACE_TASK_STACKS_IN_EXT_RAM=y
# FreeRTOS 非 ISR 函数放入 Flash 而非 IRAM（节省 ~8KB IRAM）
CONFIG_FREERTOS_PLACE_FUNCTIONS_INTO_FLASH=y

# 将 SRAM1 区域映射为 IRAM（额外 32KB，解决 IRAM 溢出 27360 字节问题）
# 注意：此选项会减少可用的 cache SRAM，但 ESP32-WROVER 有 PSRAM 可补偿
CONFIG_ESP_SYSTEM_ESP32_SRAM1_REGION_AS_IRAM=y
# 禁用硬件加速使用软件实现（节省IRAM，因硬件加速代码会内联大量IRAM）
CONFIG_MBEDTLS_HARDWARE_AES=n
CONFIG_MBEDTLS_HARDWARE_MPI=n
CONFIG_MBEDTLS_HARDWARE_SHA=n
# 禁用硬件ECC：硬件ECC定义了 MBEDTLS_ECDSA_SIGN_ALT/VERIFY_ALT，
# 与 MBEDTLS_ECP_RESTARTABLE 冲突（check_config.h:195 报错），
# 且禁用后 mbedtls_ecdsa_sign_det_restartable 才不会被 ALT 卡住。
# 纯软件ECC虽慢些，但 ESP32-WROVER 有 PSRAM 和 240MHz 主频可接受。
CONFIG_MBEDTLS_HARDWARE_ECC=n
# 禁用 ATCA 硬件 ECDSA：默认定义 MBEDTLS_ECDSA_SIGN_ALT/VERIFY_ALT，
# 导致 psa_crypto.c 调用的 mbedtls_ecdsa_sign_restartable 找不到实现。
CONFIG_MBEDTLS_ATCA_HW_ECDSA_SIGN=n
CONFIG_MBEDTLS_ATCA_HW_ECDSA_VERIFY=n
# 禁用证书捆绑（减少IRAM占用）
CONFIG_MBEDTLS_CERTIFICATE_BUNDLE=n
CONFIG_MBEDTLS_SSL_KEEP_PEER_CERTIFICATE=n
# 缩小SSL缓冲区
CONFIG_MBEDTLS_SSL_IN_CONTENT_LEN=4096
CONFIG_MBEDTLS_SSL_OUT_CONTENT_LEN=4096
# 禁用TLS服务端功能
CONFIG_ESP_TLS_SERVER=n
CONFIG_ESP_TLS_PSK_VERIFICATION=n
# 禁用ESP-NETIF L2 TUNNEL（节省IRAM）
CONFIG_ESP_NETIF_L2_TUNNEL=n
# 禁用ESP-TLS debug
CONFIG_ESP_TLS_USE_DS_PERIPHERAL=n
# mbedtls ECP 重启功能（可恢复签名）
# 必须启用！因为 mbedtls_ecdsa_sign 函数只在 ECP_RESTARTABLE 启用时编译。
# 禁用 ECP_RESTARTABLE 会导致 mbedtls_ecdsa_sign_det_restartable 调用
# mbedtls_ecdsa_sign 时链接失败（undefined reference）。
# 同时禁用 ECDSA_DETERMINISTIC，让 ecdsa.c 编译非确定性版本
# (mbedtls_ecdsa_sign_restartable)，供 psa_crypto.c 调用。
CONFIG_MBEDTLS_ECP_RESTARTABLE=y
CONFIG_MBEDTLS_ECDSA_DETERMINISTIC=n

# mbedtls 配置：启用 ECDSA（解决 undefined reference to mbedtls_ecdsa_sign）
CONFIG_MBEDTLS_ECDSA_C=y
CONFIG_MBEDTLS_ECP_C=y
CONFIG_MBEDTLS_ECP_DP_SECP256R1_ENABLED=y

# wear_levelling 配置（用于 retro-core FAT 分区）
CONFIG_WL_SECTOR_SIZE=4096

# newlib nano 格式（减少 newlib 代码体积）
CONFIG_NEWLIB_NANO_FORMAT=y

# 蓝牙经典模式 + A2DP Sink（音频输出抽象层 Phase 3）
CONFIG_BT_ENABLED=y
CONFIG_BT_CLASSIC_ENABLED=y
CONFIG_BT_BLE_ENABLED=n
CONFIG_BT_BLUEDROID_ENABLED=y
CONFIG_BT_A2DP_ENABLE=y
# 蓝牙控制器：仅 BR/EDR 模式（禁用 BLE 控制器，节省大量 IRAM 和 DRAM）
CONFIG_BTDM_CTRL_MODE_BR_EDR_ONLY=y
# 仅需要 1 个 ACL 连接（1 台手机）
CONFIG_BTDM_CTRL_BR_EDR_MAX_ACL_CONN=1
# 禁用蓝牙调试日志（节省 rodata 空间）
CONFIG_BT_STACK_NO_LOG=y
# 减少蓝牙警报数量（节省内存）
CONFIG_BT_ALARM_MAX_NUM=10
# 蓝牙内存从 PSRAM 优先分配（节省内部 DRAM）
CONFIG_BT_ALLOCATION_FROM_SPIRAM_FIRST=y
# BT/BLE 动态内存分配（减少静态 BSS 占用）
CONFIG_BT_BLE_DYNAMIC_ENV_MEMORY=y
# 减少 BT 任务栈大小（节省内存）
CONFIG_BT_BTC_TASK_STACK_SIZE=1536
CONFIG_BT_BTU_TASK_STACK_SIZE=2048
# host 侧 ACL 连接数减到 1（仅 1 台手机，减少 L2CAP/BTM 静态连接控制块 BSS）
CONFIG_BT_ACL_CONNECTIONS=1
# 经典蓝牙 host 认证/一致性测试支持（默认 n，显式保持关闭）
# CONFIG_BT_CLASSIC_BQB_ENABLED is not set

# 禁用测试框架（unity/cmock 若被链接会产生 ~33KB 无用 BSS/rodata）
CONFIG_UNITY_ENABLE_IDF_TEST_RUNNER=n
CONFIG_UNITY_ENABLE_FLOAT=n
CONFIG_UNITY_ENABLE_DOUBLE=n
CONFIG_UNITY_ENABLE_64BIT=n
CONFIG_UNITY_ENABLE_COLOR=n
CONFIG_UNITY_ENABLE_FIXTURE=n

# ============================================================================
# 看门狗定时器配置（I-03 Coze Review 改进）
# ============================================================================
# TWDT（Task Watchdog Timer） - 监控任务是否卡死
# 启用后，被 TWDT 监控的任务若超过超时时间未让步（如 vTaskDelay），
# 则会触发打印或系统重启，有助于发现任务死循环。
# 超时时间：5秒（足够长，避免 LVGL 渲染等耗时操作误触发）
CONFIG_ESP_TASK_WDT=y
CONFIG_ESP_TASK_WDT_PANIC=y
CONFIG_ESP_TASK_WDT_TIMEOUT_S=5
CONFIG_ESP_TASK_WDT_CHECK_IDLE_TASK_CPU0=y
CONFIG_ESP_TASK_WDT_CHECK_IDLE_TASK_CPU1=y
```
